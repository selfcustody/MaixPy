## components/micropython/Kconfig
```kconfig
config COMPONENT_MICROPYTHON_ENABLE
	bool "Enbale micropython component"
	default n
	select COMPONENT_KENDRYTE_SDK_ENABLE
	select COMPONENT_DRIVERS_ENABLE
	select COMPONENT_SPIFFS_ENABLE
	select COMPONENT_UTILS_ENABLE

menu "Micropython configurations"
	depends on COMPONENT_MICROPYTHON_ENABLE
	config MAIXPY_GC_HEAP_SIZE
		hex "GC heap size, hex format, MUST be aligned 8 Bytes, default 512kB(0x80000)"
		default 0x80000
	menu "Modules configurations"

		config MAIXPY_IDE_SUPPORT
			bool "Enable MaixPy IDE protocol support"
			default y

		config MAIXPY_THREAD_ENABLE
			bool "Enable _thread module"
			default y
			select FREERTOS_ENABLE
			select STATIC_TASK_CLEAN_UP_ENABLE

		config MAIXPY_OMV_MINIMUM
			bool "Minimum size OMV function (just disable omv advanced functions )"
			default n

		config MAIXPY_OMV_CONV_YUV_FAST
			bool "Add YUV convert table, speed up convert but more code"
			default n

		config MAIXPY_OMV_DOUBLE_BUFF
			bool "Set double buffer for sensor(camera)"
			default y

		config MAIXPY_OMV_BINARY_OPS
			bool "Enable binary operations in OMV"
			default n

		config MAIXPY_OMV_MATH_OPS
			bool "Enable math operations in OMV"
			default n

		config MAIXPY_OMV_MEDIAN
			bool "Enable median() in OMV"
			default n

		config MAIXPY_OMV_QRCODES
			bool "Enable find_qrcodes() in OMV"
			default n

		config MAIXPY_NETWORK_ENABLE
			bool "Enable networking"
			default y

		config MICROPYTHON_PY_URE_ENABLE
			bool "Enable re"
			default y

		config MICROPYTHON_ULAB_ENALBE
			bool "Enable ulab module(a numpy-like fast vector module)"
			default y

		config MICROPYTHON_KMODEL_V4_SUPPORT
			bool "support v4 kmodel"
			default n

		config MICROPY_SSL_ENABLE
			bool "Enable Https SSL"
			default n

		config MAIXPY_WIZNET5K_ENABLE
			bool "Enable WIZNET5K"
			default n
			select WIZNET5K_ENABLE

		config MAIXPY_FLASH_ENABLE
			bool "Enable flash module"
			default n

		config MAIXPY_HASHLIB_ENABLE
			bool "Enable hashlib module"
			default y

		config MAIXPY_BTC_HASHLIB_ENABLE
			bool "Enable bitcoin-specific hashlib module"
			default n

		config MAIXPY_QRCODE_ENABLE
			bool "Enable qrcode module"
			default n

		config MAIXPY_SECP256K1_ENABLE
			bool "Enable secp256k1-embedded module"
			default n

		config MAIXPY_SHANNON_ENABLE
			bool "Enable shannon module"
			default n

		config MAIXPY_BASE32_ENABLE
			bool "Enable base32 module"
			default n

		config MAIXPY_BASE43_ENABLE
			bool "Enable base43 module"
			default n

		config MAIXPY_BC_UR_ENABLE
			bool "Enable bc-ur module (Blockchain Commons UR for QR codes)"
			default n

		config MAIXPY_USE_MEMZIP
			bool "Use memzip instead of frozen mpy"
			default n
	endmenu

	menu "Builtin py modules configurations"

		config MAIXPY_BUILTIN_PY_PYE
			bool "Enable builtin py module pye (about 17KiB)"
			default y
		config MAIXPY_BUILTIN_PY_BOARD
			bool "Enable builtin py module board"
			default y
		config MAIXPY_BUILTIN_PY_FPIOA_MANAGER
			bool "Enable builtin py module fpioa_manager"
			default y
	endmenu

	menu "Debug configurations"
		config MAIXPY_K210_UARTHS_DEBUG
			bool "Use UARTHS to debug(pin9, pin10), UART2 to REPL(pin4, pin5)"
			default n

	endmenu

	config BUILTIN_PY_DIR
		string "builtin py directory"
		default ""
endmenu

menu "Others"
	depends on COMPONENT_MICROPYTHON_ENABLE
	config COMPONENT_LIB_SIPEED_KPU_SRC_ENABLE
		bool "Compile lib_sipeed_kpu source code"
		default n
endmenu
```
